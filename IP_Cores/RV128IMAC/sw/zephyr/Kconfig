## IP_Cores/RV128IMAC/sw/zephyr/boards/adriangreenboy/rv128imac_soc/board.yml
```yaml
board:
  name: rv128imac_soc
  full_name: RV128IMAC SoC (RV64 mode)
  vendor: adriangreenboy
  socs:
    - name: rv128imac
```

## IP_Cores/RV128IMAC/sw/zephyr/boards/adriangreenboy/rv128imac_soc/rv128imac_soc_defconfig
```kconfig
CONFIG_CONSOLE=y
CONFIG_SERIAL=y
CONFIG_UART_CONSOLE=y
CONFIG_STACK_SENTINEL=y
CONFIG_XIP=n
CONFIG_RISCV_PMP=n
```

## IP_Cores/RV128IMAC/sw/zephyr/soc/adriangreenboy/rv128imac/Kconfig
```kconfig
config SOC_RV128IMAC
	select RISCV
	select RISCV_PRIVILEGED
	select RISCV_HAS_PLIC
	select RISCV_SOC_HAS_GP_RELATIVE_ADDRESSING
	select ATOMIC_OPERATIONS_BUILTIN
	help
	  RV128IMAC SoC: dual RV128/RV64 core started in RV64 mode, I$/D$, 128-bit AXI4,
	  CLINT, PLIC (31 sources), UART 16550. Machine mode only, no PMP.
	  Own __reset (soc.S): the register file has no reset value.
```

## IP_Cores/RV128IMAC/sw/zephyr/soc/adriangreenboy/rv128imac/Kconfig.defconfig
```kconfig
if SOC_RV128IMAC

config SYS_CLOCK_HW_CYCLES_PER_SEC
	default 1000000          # mtime: 1 MHz (board DTS); in simulation clk/TIME_DIV

config RISCV_SOC_INTERRUPT_INIT
	default y

config 2ND_LVL_ISR_TBL_OFFSET
	default 12

config 2ND_LVL_INTR_00_OFFSET
	default 11

config 2ND_LEVEL_INTERRUPT_BITS
	default 11

config MAX_IRQ_PER_AGGREGATOR
	default 32

config NUM_IRQS
	default 44               # 12 local + 32 PLIC

config RISCV_PMP
	default n

config XIP
	default n

endif
```
